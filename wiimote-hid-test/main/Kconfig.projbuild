## wiimote-hid-test/main/Kconfig.projbuild
```kconfig
menu "HID Example Configuration"
    config EXAMPLE_SSP_ENABLED
        bool "Secure Simple Pairing"
        depends on BT_CLASSIC_ENABLED
        default y
        help
            This enables the Secure Simple Pairing. If disable this option,
            Bluedroid will only support Legacy Pairing

    config EXAMPLE_LOCAL_DEVICE_NAME
        string "Local Device Name"
        default "HID Mouse Example"
        help
            Use this option to set local device name.

    config EXAMPLE_LIMITED_DISCOVERABLE
        bool "Advertise as limited discoverable (match RVL-CNT-01)"
        depends on BT_CLASSIC_ENABLED
        default y
        help
            Select startup discoverability when Wi-Fi web control is disabled.
            The web SYNC button always uses a bounded limited-discovery window
            with CoD 0x002504. Controllers supporting only one inquiry access
            code alternate LIAC/GIAC during that window. General/GIAC-only
            discovery remains available at /api/sync/general for diagnostics.

    config EXAMPLE_FAKE_BUTTON_DEMO
        bool "Cycle fake core buttons while connected"
        depends on BT_CLASSIC_ENABLED
        default n
        help
            Repeatedly press and release each of the 11 Wii Remote core
            buttons in sequence after the host selects continuous report 0x30.
            Keep disabled when using Wi-Fi web control.

    config EXAMPLE_BT_DISCOVERY_TRACE
        bool "Trace Bluetooth discovery HCI commands and connection events"
        depends on BT_CLASSIC_ENABLED && BT_BLUEDROID_ENABLED
        default n
        help
            Project-local diagnostic for the ESP-IDF 6 Bluedroid transport.
            Log selected HCI commands, their controller completion status, and
            connection events without changing packets. PIN values, link keys,
            and ACL payloads are excluded. This does not capture radio inquiry
            packets; those are handled inside the controller. Disable for
            normal use. No ESP-IDF source or global driver changes are made.

    config EXAMPLE_WIFI_WEB_CONTROL
        bool "Enable Wi-Fi web button controller"
        depends on BT_CLASSIC_ENABLED
        default y
        help
            Connect as a Wi-Fi station and serve a local web page for Wii Remote
            button press/release control. Configure the station SSID and password
            below. Do not commit those credentials.

    config EXAMPLE_WIFI_SSID
        string "Wi-Fi SSID"
        depends on EXAMPLE_WIFI_WEB_CONTROL
        default ""
        help
            Wi-Fi station network name. Keep the password out of source control.

    config EXAMPLE_WIFI_PASSWORD
        string "Wi-Fi password"
        depends on EXAMPLE_WIFI_WEB_CONTROL
        default ""
        help
            Wi-Fi station password. This value is stored in the local ignored
            sdkconfig and compiled into firmware; never commit it.
endmenu
```

## wiimote-hid-test/sdkconfig.defaults
```kconfig
CONFIG_BT_ENABLED=y
CONFIG_BTDM_CTRL_MODE_BLE_ONLY=n
CONFIG_BTDM_CTRL_MODE_BR_EDR_ONLY=y
CONFIG_BTDM_CTRL_MODE_BTDM=n
CONFIG_BT_CLASSIC_ENABLED=y
CONFIG_BT_HID_ENABLED=y
CONFIG_BT_HID_DEVICE_ENABLED=y
CONFIG_BT_SDP_COMMON_ENABLED=y
CONFIG_ESPTOOLPY_FLASHSIZE_4MB=y
CONFIG_PARTITION_TABLE_SINGLE_APP_LARGE=y
CONFIG_EXAMPLE_LOCAL_DEVICE_NAME="Nintendo RVL-CNT-01"
CONFIG_EXAMPLE_LIMITED_DISCOVERABLE=y
CONFIG_EXAMPLE_FAKE_BUTTON_DEMO=n
CONFIG_EXAMPLE_WIFI_WEB_CONTROL=y
CONFIG_EXAMPLE_WIFI_SSID=""
CONFIG_BT_SDP_ATTR_LEN=512
CONFIG_BT_SDP_PAD_LEN=1024
```
